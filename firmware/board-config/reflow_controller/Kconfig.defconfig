## firmware/board-config/reflow_controller/Kconfig.defconfig
```kconfig
# Reflow oven controller configuration

# Copyright (c) 2016 Open-RnD Sp. z o.o.
# SPDX-License-Identifier: Apache-2.0

if BOARD_REFLOW_CONTROLLER

config BOARD
	default "reflow_controller"

endif # BOARD_REFLOW_CONTROLLER
```

## firmware/boards/arm/reflow_controller/Kconfig.board
```kconfig
# Reflow oven controller configuration

# Copyright (c) 2016 Open-RnD Sp. z o.o.
# SPDX-License-Identifier: Apache-2.0

config BOARD_REFLOW_CONTROLLER
	bool "Reflow Oven Controller"
	depends on SOC_STM32F103XB
```

## firmware/boards/arm/reflow_controller/Kconfig.defconfig
```kconfig
# Reflow oven controller configuration

# Copyright (c) 2016 Open-RnD Sp. z o.o.
# SPDX-License-Identifier: Apache-2.0

if BOARD_REFLOW_CONTROLLER

config BOARD
	default "reflow_controller"

config SPI_STM32_INTERRUPT
    default y
    depends on SPI

endif # BOARD_REFLOW_CONTROLLER
```

## firmware/drivers/thermocouple_module/zephyr/Kconfig
```kconfig
# SPDX-License-Identifier: Apache-2.0

config THERMOCOUPLE_DRIVER
    bool "Enable support for the thermocouple driver"
```
